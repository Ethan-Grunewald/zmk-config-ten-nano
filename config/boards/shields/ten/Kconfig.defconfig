## config/boards/shields/ten/Kconfig.defconfig
```kconfig
# Copyright (c) 2022 The ZMK Contributors
# SPDX-License-Identifier: MIT

if SHIELD_TEN_LEFT

config ZMK_KEYBOARD_NAME
    default "Ten"

config ZMK_SPLIT_ROLE_CENTRAL
    default y

endif

if SHIELD_TEN_LEFT || SHIELD_TEN_RIGHT
config ZMK_SPLIT
    default y
endif
```

## config/boards/shields/ten/Kconfig.shield
```kconfig
# Copyright (c) 2022 The ZMK Contributors
# SPDX-License-Identifier: MIT

config SHIELD_TEN_LEFT
    def_bool $(shields_list_contains,ten_left)

config SHIELD_TEN_RIGHT
    def_bool $(shields_list_contains,ten_right)
```

## config/west.yml
```yaml
manifest:
  remotes:
    - name: zmkfirmware
      url-base: https://github.com/zmkfirmware
    - name: ethangrunewald
      url-base: https://github.com/Ethan-Grunewald
  projects:
    - name: zmk
      remote: zmkfirmware
      revision: main
      import: app/west.yml
    - name: nice-view-mod
      remote: ethangrunewald
      revision: main
  self:
    path: config
```
